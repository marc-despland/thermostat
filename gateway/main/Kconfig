## gateway/main/Kconfig
```kconfig
menu "Gateway Configuration"

    config THERMOSTAT_ENABLE_CLI
        bool "Enable Console CLI Commands"
        default y
        help
            Reserved for future console CLI commands for device pairing and
            management (permit_join <duration>, list_devices, remove_device
            <index>). Not implemented yet - guard any future CLI code behind
            this option.

    config THERMOSTAT_DEFAULT_CHANNEL
        int "Zigbee Channel (15-25)"
        default 25
        range 15 25
        help
            Primary Zigbee channel (15, 20, 25 recommended).
            KETOTEK typically uses 15, 20, or 25.

    config THERMOSTAT_MAX_CHILDREN
        int "Maximum Child Devices"
        default 10
        range 1 32
        help
            Maximum number of child devices that can be connected.

endmenu
```

## old/main/Kconfig
```kconfig
menu "Thermostat Gateway Configuration"

    config EXAMPLE_CONNECT_WIFI
        bool "Connect to WiFi"
        default n
        help
            Set this to true to connect the gateway to WiFi for remote management.

    config EXAMPLE_WIFI_SSID
        string "WiFi SSID"
        depends on EXAMPLE_CONNECT_WIFI
        default "myssid"
        help
            SSID of the router.

    config EXAMPLE_WIFI_PASSWORD
        string "WiFi Password"
        depends on EXAMPLE_CONNECT_WIFI
        default "mypassword"
        help
            WiFi password (WPA or WPA2).

    config THERMOSTAT_ENABLE_CLI
        bool "Enable Console CLI Commands"
        default y
        help
            Enable CLI commands for device pairing and management:
            - permit_join <duration>
            - list_devices
            - remove_device <index>

    config THERMOSTAT_DEFAULT_CHANNEL
        int "Zigbee Channel (15-25)"
        default 25
        range 15 25
        help
            Primary Zigbee channel (15, 20, 25 recommended).
            KETOTEK typically uses 15, 20, or 25.

    config THERMOSTAT_MAX_CHILDREN
        int "Maximum Child Devices"
        default 10
        range 1 32
        help
            Maximum number of child devices that can be connected.

endmenu
```

## prototype/thermostat/main/Kconfig
```kconfig
menu "Thermostat Simulator Configuration"

    config THERMOSTAT_SIM_REPORT_INTERVAL_SEC
        int "Simulated DP report interval (seconds)"
        default 30
        range 5 3600
        help
            How often the simulated KETOTEK sends an unprompted Tuya DP
            report (local temperature, setpoint, state) after joining the
            gateway's network, mimicking the real device's autonomous
            periodic reporting behavior.

endmenu
```
